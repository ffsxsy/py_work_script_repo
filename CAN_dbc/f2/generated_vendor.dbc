VERSION ""

NS_ :

BS_:

BU_:

BO_ 257 A1_EnvData: 8 A1
 SG_ 湿度 : 16|16@1+ (0.1,0.0) [0|0] "%RH" Vector__XXX
 SG_ 温度 : 0|16@1+ (0.1,-40.0) [0|0] "degC" Vector__XXX

BO_ 258 A2_EnvData: 8 A2
 SG_ 湿度 : 16|16@1+ (0.1,0.0) [0|0] "%RH" Vector__XXX
 SG_ 温度 : 0|16@1+ (0.1,-40.0) [0|0] "degC" Vector__XXX

BO_ 513 B1_EnvData: 8 B1
 SG_ 气压 : 16|16@1+ (0.01,0.0) [0|0] "kPa" Vector__XXX
 SG_ 温度 : 0|16@1+ (0.1,-40.0) [0|0] "degC" Vector__XXX

CM_ BO_ 257 "仓间东侧 | 厂商A型温湿度模块";
CM_ BO_ 258 "仓间西侧 | 厂商A型温湿度模块";
CM_ BO_ 513 "机房 | 厂商B型气压模块";
BA_DEF_ BO_  "GenMsgCycleTime" INT 0 65535;
BA_DEF_ SG_  "GenSigStartValue" FLOAT 0 100000000000;
BA_DEF_DEF_  "GenMsgCycleTime" 0;
BA_DEF_DEF_  "GenSigStartValue" 0;
BA_ "GenMsgCycleTime" BO_ 257 100;
BA_ "GenMsgCycleTime" BO_ 258 100;
BA_ "GenMsgCycleTime" BO_ 513 100;
