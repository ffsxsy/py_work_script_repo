VERSION ""

NS_ :

BS_:

BU_:

BO_ 257 A1_EnvData: 8 A1
 SG_ Humidity : 16|16@1+ (0.1,0.0) [0|0] "%RH" Vector__XXX
 SG_ Temperature : 0|16@1+ (0.1,-40.0) [0|0] "degC" Vector__XXX

BO_ 258 A2_EnvData: 8 A2
 SG_ Humidity : 16|16@1+ (0.1,0.0) [0|0] "%RH" Vector__XXX
 SG_ Temperature : 0|16@1+ (0.1,-40.0) [0|0] "degC" Vector__XXX

BO_ 513 B1_EnvData: 8 B1
 SG_ Pressure : 16|16@1+ (0.01,0.0) [0|0] "kPa" Vector__XXX
 SG_ Temperature : 0|16@1+ (0.1,-40.0) [0|0] "degC" Vector__XXX

CM_ BO_ 257 "A类设备实例A1";
CM_ BO_ 258 "A类设备实例A2";
CM_ BO_ 513 "B类设备实例B1";
BA_DEF_ BO_  "GenMsgCycleTime" INT 0 65535;
BA_DEF_ SG_  "GenSigStartValue" FLOAT 0 100000000000;
BA_DEF_DEF_  "GenMsgCycleTime" 0;
BA_DEF_DEF_  "GenSigStartValue" 0;
BA_ "GenMsgCycleTime" BO_ 257 100;
BA_ "GenMsgCycleTime" BO_ 258 100;
BA_ "GenMsgCycleTime" BO_ 513 100;
